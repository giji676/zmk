## config/boards/shields/test/Kconfig.defconfig
```kconfig
if SHIELD_TEST

config ZMK_KEYBOARD_NAME
    default "test"

endif
# if SHIELD_TEST_LEFT
#
# config ZMK_KEYBOARD_NAME
#     default "test"
#
# config ZMK_SPLIT_ROLE_CENTRAL
#     default y
#
# endif
#
# if SHIELD_WYLD_DM_LEFT || SHIELD_WYLD_DM_RIGHT
#
# config ZMK_SPLIT
#     default y
#
# endif
#
```
